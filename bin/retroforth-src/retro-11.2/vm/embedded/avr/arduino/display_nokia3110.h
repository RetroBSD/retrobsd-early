#ifndef DISPLAY_NOKIA3110_H
#define DISPLAY_NOKIA3110_H
#ifdef DISPLAY_ACTIVATED
#error "Only one display can be activated."
#endif
#define DISPLAY_ACTIVATED

#define DISPLAY_WIDTH 14
#define DISPLAY_HEIGHT 6

typedef unsigned char display_t;

static void display_init();
static void display_write_byte(display_t dat, display_t dat_type);
#if display_DRAW_PIXEL_ACTIVATED
static void display_draw_bmp_pixel(display_t x, display_t y, display_t *map, display_t pix_x, display_t pix_y);
#endif
static void display_write_char(display_t c, char mode);
static void display_write_string(char *s, char mode);
static void display_set_xy(display_t x, display_t y);
static void display_clear(void);

static display_t display_font6_8[][6] PROGMEM =
{
    { 0x00, 0x00, 0x00, 0x00, 0x00, 0x00 },   // sp
    { 0x00, 0x00, 0x00, 0x2f, 0x00, 0x00 },   // !
    { 0x00, 0x00, 0x07, 0x00, 0x07, 0x00 },   // "
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    { 0x00, 0x00, 0x06, 0x09, 0x09, 0x06 }    // horiz lines
};

static void display_init()
{
    SPI_DDR |= (1<<SPI_CS)|(1<<SPI_MOSI)|(1<<SPI_SCK);
    DISPLAY_DDR |= (1<<DISPLAY_DC)|(1<<DISPLAY_RST);

    DISPLAY_PORT &= ~(1<<DISPLAY_RST);
    _delay_ms(100);
    DISPLAY_PORT |= (1<<DISPLAY_RST);
    SPCR = 0x51;   // enable SPI master, fosc/16 = 1MH

    display_write_byte(0x21, 0);
    display_write_byte(0xc6, 0);
    display_write_byte(0x06, 0);
    display_write_byte(0x13, 0);
    display_write_byte(0x20, 0);
    display_clear();
    display_write_byte(0x0c, 0);
}

static void display_write_byte(display_t dat, display_t dat_type)
{
    SPI_PORT &= ~(1<<SPI_CS);
    if (dat_type == 0) DISPLAY_PORT &= ~(1<<DISPLAY_DC);
    else DISPLAY_PORT |= (1<<DISPLAY_DC);
    SPDR = dat;
    while ((SPSR & 0x80) == 0);
    SPI_DDR |= (1<<SPI_CS);
}


#if display_DRAW_PIXEL_ACTIVATED
static void display_draw_bmp_pixel(display_t x, display_t y, display_t *map, display_t pix_x, display_t pix_y)
{
    unsigned int i,n;
    display_t row;

    if (pix_y % 8 == 0) row = pix_y / 8;
    else row = pix_y / 8 + 1;

    for (n=0; n < row; n++) {
        display_set_xy(x,y);
        for (i=0; i < pix_x; i++)
            display_write_byte(map[i+n*pix_x], 1);
        y++;
    }
}
#endif

static void display_write_string(char *s, char mode)
{
    for(; *s; s++) display_write_char(*s, mode);
}

static void display_write_char(display_t c, char mode)
{
    display_t line;
    display_t *pfont;
    char ch;

    pfont = (display_t *)display_font6_8;
    c -= 32;

    for (line=0; line < 6; line++) {
        ch = pgm_read_byte(pfont+c*6+line);
        display_write_byte(mode == 0 ? ch : (ch^ 0xff), 1);
    }
}

static void display_set_xy(display_t x, display_t y)
{
    display_write_byte(0x40 | y, 0);
    display_write_byte(0x80 | x * 6, 0);
}

static void display_clear(void)
{
    unsigned int i;

    display_write_byte(0x0c, 0);
    display_write_byte(0x80, 0);

    for (i=0; i<504; i++)
        display_write_byte(0, 1);
}

#endif
